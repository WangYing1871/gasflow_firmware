## app/Kconfig
```kconfig
menu "Zephyr"
source "Kconfig.zephyr"
endmenu

module = gasflow_firmware
module-str = gasflow_firmware
source "subsys/logging/Kconfig.template.log_config"
```

## dts/bindings/pwm-pump.yaml
```yaml
# Copyright (c) 2022 Nordic Semiconductor ASA
# SPDX-License-Identifier: Apache-2.0

description: PWM-driven pump

compatible: "pwm-pump"

include: base.yaml

properties:
  pwms:
    required: true
    type: phandle-array
    description: PWM specifier driving the servo motor.

  min-pulse:
    required: false
    type: int
    description: Minimum pulse width (nanoseconds).

  max-pulse:
    required: false
    type: int
    description: Maximum pulse width (nanoseconds).

  default-speed:
    required: false
    type: int
    description: Default speed of the pump (permil).
```

## lib/Kconfig
```kconfig
config MFC_ACU20FD
	bool "Support for mass-flow-controller ACU20FD"
  depends on MODBUS
	help
	  This option enables the ACU20FD mass-flow-controller support
```
